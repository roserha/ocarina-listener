## ocarina-os/meta-ocarina/conf/layer.conf
```bitbake
BBPATH .= ":${LAYERDIR}"
BBFILES += "${LAYERDIR}/recipes-*/*/*.bb"
BBFILE_COLLECTIONS += "ocarina"
BBFILE_PATTERN_ocarina = "^${LAYERDIR}/"
BBFILE_PRIORITY_ocarina = "6"
LAYERSERIES_COMPAT_ocarina = "scarthgap"
```
