## ocarina-os/meta-ocarina/conf/distro/ocarinaos.conf
```bitbake
require conf/distro/poky.conf

DISTRO = "ocarinaos"
DISTRO_NAME = "OcarinaOS"
DISTRO_CODENAME = "ocarina"
HOSTNAME = "ocarinaos"
MACHINE_HOSTNAME = "ocarinaos"
OCARINA_GIT_HASH ?= "unknown"
DISTRO_VERSION = "2.0.1+${OCARINA_GIT_HASH}"
```
